## presentaciones/qemu-arm/myassets/scripts/my_defconfig
```kconfig
CONFIG_PCI=y
CONFIG_VIRT_DRIVERS=y
CONFIG_VIRTIO_PCI=y
CONFIG_VIRTIO_BLK=y
CONFIG_SCSI_VIRTIO=y
CONFIG_PCI_HOST_GENERIC=y
CONFIG_DRM=y
CONFIG_DRM_VIRTIO_GPU=y
CONFIG_HIGHMEM=n
CONFIG_ARM_LPAE=y
```
